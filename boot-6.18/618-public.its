## boot-6.18/618-public.its
```
/dts-v1/;
/ {
    description = "Kernel fitImage for Hailo-15 / 6.18.52 / public EVB";
    #address-cells = <1>;

    images {
        kernel-1 {
            description = "Linux 6.18.52 MACB (Hailo GEM port)";
            data = /incbin/("kernel.gz");
            type = "kernel";
            arch = "arm64";
            os = "linux";
            compression = "gzip";
            load = <0x80c00000>;
            entry = <0x80c00000>;
            hash-1 {
                algo = "sha256";
                checksum = "yes";
            };
        };

        fdt-evb.dtb {
            description = "Hailo-15 EVB 2-camera VPU device tree (public Hailo dts)";
            data = /incbin/("board.dtb");
            type = "flat_dt";
            arch = "arm64";
            compression = "none";
            load = <0x80800000>;
            hash-1 {
                algo = "sha256";
                checksum = "yes";
            };
        };
    };

    configurations {
        default = "conf-evb.dtb";

        conf-evb.dtb {
            description = "6.18 + public Hailo-15 EVB dtb";
            kernel = "kernel-1";
            fdt = "fdt-evb.dtb";
            hash-1 {
                algo = "sha256";
                checksum = "yes";
            };
        };
    };
};
```

## boot-6.18/618-truen.its
```
/dts-v1/;
/ {
    description = "Linux 6.18.52 Hailo15 TRUEN FIT";
    #address-cells = <1>;

    images {
        kernel-1 {
            description = "Linux 6.18.52";
            data = /incbin/("kernel.gz");
            type = "kernel";
            arch = "arm64";
            os = "linux";
            compression = "gzip";
            load = <0x80c00000>;
            entry = <0x80c00000>;
            hash-1 { algo = "sha256"; };
        };

        fdt-truen_truen_board.dtb {
            description = "TRUEN board device tree";
            data = /incbin/("board.dtb");
            type = "flat_dt";
            arch = "arm64";
            compression = "none";
            load = <0x80800000>;
            hash-1 { algo = "sha256"; };
        };
    };

    configurations {
        default = "conf-truen_truen_board.dtb";
        conf-truen_truen_board.dtb {
            description = "Linux kernel and TRUEN board device tree";
            kernel = "kernel-1";
            fdt = "fdt-truen_truen_board.dtb";
            signature-1 {
                algo = "sha256,rsa3072";
                key-name-hint = "customer";
                sign-images = "kernel", "fdt";
            };
        };
    };
};
```

## kernel/drivers/gpu/drm/hailo/Kconfig
```kconfig
# SPDX-License-Identifier: GPL-2.0

config DRM_HAILO
	tristate "HAILO Display"
	depends on DRM
	select DRM_KMS_HELPER
	# 6.18: KMS CMA helper renamed KMS_CMA->GEM_DMA
	select DRM_GEM_DMA_HELPER
	help
	  This is a DRM display driver for HAILO Displays or display
	  adapters.

	  If M is selected the module will be called hailo.
```

## kernel/drivers/media/platform/hailo/hailo15/Kconfig
```kconfig
# SPDX-License-Identifier: GPL-2.0-only
config VIDEO_HAILO15
	bool "Hailo15 video Devices"
	depends on MEDIA_SUPPORT
	select VIDEO_DEV
	select VIDEO_V4L2_SUBDEV_API
	select V4L2_FWNODE
	select VIDEOBUF2_DMA_CONTIG
	help
	  If you have a media device from hailo15 series, say Y.

	  Note that this option doesn't include new drivers in the kernel:
	  saying N will just cause Kconfig to skip all the questions about
	  hailo15 media devices.

if VIDEO_HAILO15

config VIDEO_HAILO15_CSI2RX
	tristate "Hailo15 Cadence CSI2 receiver"
	depends on ARCH_HAILO15
	depends on VIDEO_CADENCE_CSI2RX = n
	select GENERIC_PHY
	select GENERIC_PHY_MIPI_DPHY
	help
	  Hailo 전용 HDR, VC 선택 및 내부 D-PHY 연결을 지원한다.
	  동일 DT 노드를 사용하는 범용 Cadence 드라이버와 함께 켜지 않는다.

config VIDEO_HAILO15_DPHY
	tristate "Hailo15 MIPI D-PHY"
	select GENERIC_PHY
	select GENERIC_PHY_MIPI_DPHY

config VIDEO_HAILO15_VIDEO_CAPTURE
	tristate "Hailo15 video capture device"

config VIDEO_HAILO15_VIDEO_OUTPUT
	tristate "Hailo15 video output device"

config VIDEO_HAILO15_ENCODER
	tristate "Hailo15 VC8000E encoder"
	depends on ARCH_HAILO15
	select DMA_SHARED_BUFFER
	help
	  Hailo 영상 라이브러리의 hx280enc 장치 ABI를 제공한다.

config VIDEO_HAILO15_PIX_MUX
	tristate "Hailo15 pixel-mux driver"
	help
	  Support for the hailo15 pixel mux driver.

	  To compile this driver as a module, choose M here: the module will be
	  called hailo15-pixel-mux.

config VIDEO_HAILO15_RXWRAPPER
	tristate "Hailo15 rxwrapper driver"
	help
	  Support for the hailo15 rxwrapper driver.

	  To compile this driver as a module, choose M here: the module will be
	  called hailo15-rxwrapper.

config VIDEO_HAILO15_ISP
	tristate "Hailo15 ISP driver"
	help
		Support for Hailo15 ISP

config VIDEO_HAILO15_AF_MONITOR_EXAMPLE
	tristate "Hailo15 af monitor example"
	help
		Support for Hailo15 AF

endif
```
